/*
 * BackgroundServices.c
 *
 * Created: 04-Apr-17 14:54:25
 *  Author: maticpi
 */ 
#include "BackgroundServices.h"

int score;
int level;
int lives;
char display_msg;	//1,2,3 or 4

void BackgroundServices()
{
	static uint32_t last_time;
	
	if (Has_X_MillisecondsPassed(10,&last_time))
	{
		KBD_Read();
	}
	RefreshLCDandLEDs();
}

void RefreshLCDandLEDs()
{
	switch (display_msg)
	{
		case DISP_MOLE1:
//			LED_ShowMoleNr(1);
			LCD_ShowMoleNr(1);
			break;
		case DISP_MOLE2:
//			LED_ShowMoleNr(2);
			LCD_ShowMoleNr(2);
			break;
		case DISP_MOLE3:
//			LED_ShowMoleNr(3);
			LCD_ShowMoleNr(3);
			break;
		case DISP_MOLE4:
//			LED_ShowMoleNr(4);
			LCD_ShowMoleNr(4);
			break;
		case DISP_MOLE_NONE:
//			LED_ShowMoleNr(0);
			LCD_ShowMoleNr(0);
			break;
		case DISP_MOLE_ALL:
//			LED_ShowMoleNr(5);
			LCD_ShowMoleNr(5);
			break;
		case DISP_REFRESH_SCORE:
			LCD_RefreshScore();
			break;
		case DISP_REFRESH_LEVEL:
			LCD_RefreshLevel();
			break;
		case DISP_REFRESH_LIVES:
			LCD_RefreshLives();
			break;
		case DISP_REFRESH_ALL:
			LCD_RefreshScore();
			LCD_RefreshLevel();
			LCD_RefreshLives();
			break;
		case DISP_START_SCREEN:
			DrawStartScreen();
			break;
		case DISP_GAME_PLAY_SCREEN:
			DrawGamePlayScreen();
			LCD_RefreshScore();
			LCD_RefreshLevel();
			LCD_RefreshLives();
			break;
		case DISP_END_SCREEN:
			lives = -1;
			LCD_RefreshLives();
			DrawGameOver();
			break;
		case DSIP_END_SCORE:
			DrawGameScore();
			break;
		default:	//0 or unknown - do nothing
		break;
	}
	display_msg=0;
}

/*
void LED_ShowMoleNr(char mole_nr)
{
	if (mole_nr == 0) PORTE=0;
	else if (mole_nr == 5) PORTE=0x0f;
	else if ((mole_nr<5) && (mole_nr>0)) PORTE = 1<<(mole_nr-1);
	//else unknown code, do nothing
}
*/
void LCD_RefreshScore()
{
	char txt[10];
	static int oldLength;
	int i,lnt;
	UG_FontSelect(&RFONT_8X12);
	UG_SetForecolor(C_WHITE);
	sprintf(txt,"%d",score);
	lnt=strlen(txt);
	if (lnt<oldLength)
	{
		for (i=0;i<oldLength-lnt; i++) txt[lnt+i]=' ';
		txt[lnt+i]=0;	//termination char
	}
	UG_PutString(56,2,txt);
	oldLength=lnt;
}

void LCD_RefreshLives()
{
	static int oldLives;
	const int lX[3]={271,286,301};
	int i, clives;
			
/*	if (lives > 9)	//GREEN
	else if (lives > 6)	//BLUE
	else if (lives > 3)	//YELLOW
	else 	//RED
*/
	clives=lives;	//copy number of lives first, then adjust
					//so we don't try to draw more than possible
	if (lives == -1)	//force refresh
	{
		lives=0;
		clives=0;
		oldLives=3;
	}
	else
	{
		if (clives > 3) clives=3;
		if (clives < 0) clives=0;
		if (clives == oldLives) return;
	}
	if (clives > oldLives)	//add lives
	{
		for (i=oldLives; i<clives; i++ )
		{
			DrawIcon_P(lX[i],17,14,11,C_BLACK,C_RED,&lifeIco[0][0]);
		}	
	}
	else	//remove lives
	{
		for (i=clives; i<oldLives; i++ )
		{
			UG_FillFrame(lX[i],17,lX[i]+14,17+11,C_BLACK);
		}
	}
	oldLives=clives;
}

void LCD_RefreshLevel()
{
	char txt[10];
	static int oldLength;
	int i,lnt;
	UG_FontSelect(&RFONT_8X12);
	UG_SetForecolor(C_WHITE);
	sprintf(txt,"%d",level);
	lnt=strlen(txt);
	if (lnt<oldLength)
	{
		for (i=0;i<oldLength-lnt; i++) txt[lnt+i]=' ';
		txt[lnt+i]=0;	//termination char
	}
	UG_PutString(56,15,txt);
	oldLength=lnt;
}

void LCD_ShowMoleNr(char mole_nr)
{
	static char oldMolePositions;	//bits 0-3: 1-mole is drawn, 0-mole isn't drawn
	const int mX[4]={80-15,200-15,280-15,200-15};
	const int mY[4]={120-15,120-15,160-15,200-15};
	int i;
	
	if (mole_nr == 0 || mole_nr == 6)	//delete all moles (6 forces delete regardless of oldMolePositions )
	{
		for (i=0; i<4; i++)
		{
			if ((mole_nr == 6) || (oldMolePositions & (1<<i)))	//if present delete else do nothiing
			{
				UG_FillCircle(mX[i]+15,mY[i]+15,15,C_BLACK);
			}
		}
		oldMolePositions=0;
	}
	else if (mole_nr == 5) //draw all moles
	{
		for (i=0; i<4; i++)
		{
			if (!(oldMolePositions & (1<<i)))	//if !present draw else do nothiing
			{
				DrawSprite_P(mX[i],mY[i],30,31,C_GREEN,&sprite[0][0]);
			}
		}
		oldMolePositions=0x0F;
	}
	else if ((mole_nr<5) && (mole_nr>0))	//delete moles on the wrong positions and draw the mole on the correct position
	{
		for (i=0; i<4; i++)
		{
			if ((!(oldMolePositions & (1<<i))) && ((i+1) == mole_nr))	//if !present && needs to be here, draw 
			{
				DrawSprite_P(mX[i],mY[i],30,31,C_GREEN,&sprite[0][0]);
				oldMolePositions |= (1<<i);
			}
			else if ((oldMolePositions & (1<<i)) && ((i+1) != mole_nr))	//else if present and mustn't be, delete else do nothiing
			{
				UG_FillCircle(mX[i]+15,mY[i]+15,15,C_BLACK);
				oldMolePositions &= ~(1<<i);
			}
		}
	}
}

void DrawStartScreen()
{	//&RFONT_8X12 &RFONT_16X26
	UG_FillFrame(0,0,320,100,C_BLACK);
	UG_FillFrame(0,100,320,220,C_GREEN);
	UG_FillFrame(0,220,320,240,C_BLACK);
	UG_FontSelect(&RFONT_16X26);
	UG_SetForecolor(C_WHITE);
	UG_SetBackcolor(C_BLACK);
	UG_PutString(50,20,"WHACK A  OLE");
	UG_SetForecolor(C_RED);
	UG_PutString(185,25,"M");
	UG_FontSelect(&RFONT_8X12);
	UG_SetForecolor(C_WHITE);
	UG_PutString(5,223,"Press OK to start!");
	
	LCD_ShowMoleNr(6);	//deletes moles regardles if they were there or not
}

void DrawGamePlayScreen()
{	//&RFONT_8X12 &RFONT_16X26
	UG_FillFrame(0,0,320,100,C_BLACK);
	UG_FillFrame(0,80,320,240,C_GREEN);
	UG_FontSelect(&RFONT_8X12);
	UG_SetForecolor(C_WHITE);
	UG_PutString(2,2,"Score:");
	UG_PutString(2,15,"Level:");
	UG_PutString(272,2,"Lives");
	UG_DrawRoundFrame(268,15,318,30,4,C_WHITE);
	
	LCD_ShowMoleNr(6);	//deletes moles regardles if they were there or not
}

void DrawGameOver()
{	//&RFONT_8X12 &RFONT_16X26
	int i,x,y;
	x=GetSysTick_us() % (320-32);	//random
	y=GetSysTick_us() % (160-34);
	for (i=0; i<100; i++)
	{
		DrawSprite_P(x+1,y+81,30,31,C_GREEN,&sprite[0][0]);
		x = (x+GetSysTick_us()) % (320-32);
		y = (y+GetSysTick_us()) % (160-34);
	}
	UG_FontSelect(&RFONT_16X26);
	UG_SetForecolor(C_RED);
	UG_PutString(90,100,"GAME OVER");
}


void DrawGameScore()
{	//&RFONT_8X12 &RFONT_16X26
	char txt[10];
	UG_FontSelect(&RFONT_16X26);
	UG_SetForecolor(C_WHITE);
	UG_PutString(60,130,"Final Score:");
	sprintf(txt,"%d",score);
	UG_PutString(120,160,txt);
}
void DrawIcon_P(uint16_t x, uint16_t y, uint16_t w, uint16_t h, uint16_t bgClr, uint16_t fgClr, const uint8_t *data)
{
	uint16_t clr;
	int i,j,idx=0;
	char d=0,bit;
	
	ILI9341_setAddrWindow(x,y,x+w-1,y+h-1);
	for (j=0;j<h;j++)
	{
		for (i=0;i<w;i++)
		{
			bit = i & 0x07;
			if (bit == 0)
			{
				d=pgm_read_byte((uint16_t)data+idx);
				if (w-i>8) idx++;
			}
			clr = d & (0x80>>bit) ? fgClr : bgClr; 
			ILI9341_pushColor(clr);
		}
		idx++;
	}
}

const PROGMEM uint8_t lifeIco[11][2]={
{ 0x18, 0x60},	//0001 1000 0110 0000
{ 0x7c, 0xf8},	//0111 1100 1111 1000
{ 0xff, 0xfc},	//1111 1111 1111 1100
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{ 0x03, 0x00}	//0000 0011 0000 0000
};

void DrawSprite_P(uint16_t x, uint16_t y, uint16_t w, uint16_t h, uint16_t bgClr, const uint16_t *data)
{
	uint16_t clr;
	uint16_t size=h*w;
	int i;
	
	ILI9341_setAddrWindow(x,y,x+w,y+h);
	for (i=0;i<size;i++)
	{
		clr = pgm_read_word((uint16_t)data+2*i);
		if (!clr) clr=bgClr;
		ILI9341_pushColor(clr);
	}
}

const PROGMEM uint16_t sprite[30][31]={
	{0x0000, 0x0000, 0x0000, 0x0000, 0x0000, 0x0000, 0x0000, 0x0000, 0x0000, 0x0000, 0x0000, 0x0000, 0xBDD6, 0x6AE8, 0x8367, 0x7B8C, 0xBDD7, 0x0000, 0x0000, 0x0000, 0x0000, 0x0000, 0x0000, 0x0000, 0x0000, 0x0000, 0x0000, 0x0000, 0x0000, 0x0000, 0x0000},
	{0x0000, 0x0000, 0x0000, 0x0000, 0x0000, 0x0000, 0x0000, 0x0000, 0x0000, 0x0000, 0x0000, 0x0000, 0x7B47, 0xF70F, 0xF730, 0xE6AF, 0x49E5, 0x9CD3, 0x0000, 0x0000, 0x0000, 0x0000, 0x0000, 0x0000, 0x0000, 0x0000, 0x0000, 0x0000, 0x0000, 0x0000, 0x0000},
	{0x0000, 0x0000, 0x0000, 0x0000, 0x0000, 0x0000, 0x0000, 0x0000, 0x0000, 0x0000, 0x0000, 0x8C30, 0xE66F, 0xF777, 0xF798, 0xFF52, 0x7326, 0x39E8, 0xBD95, 0xA4D2, 0x8BED, 0x942F, 0x0000, 0x0000, 0x0000, 0x0000, 0x0000, 0x0000, 0x0000, 0x0000, 0x0000},
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	{0x9471, 0x6ACA, 0x6246, 0x8329, 0x7AC8, 0x7AE8, 0x8B49, 0x72A7, 0x4164, 0x49E7, 0x734C, 0x9C90, 0xA4F2, 0x730A, 0xAC6E, 0xC531, 0xC531, 0xBCF1, 0xB48F, 0x7B0A, 0x836B, 0xB4D0, 0x5A48, 0x730C, 0x7B4D, 0x7B2D, 0x730C, 0x5207, 0x0000, 0x0000, 0x5206}
};
